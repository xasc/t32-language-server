// SPDX-FileCopyrightText: 2024 Christoph Sax <c_sax@mailbox.org>
//
// SPDX-License-Identifier: EUPL-1.2

ENTRY %LINE &password

ENTRY &user %line &pw

RETURNVALUES "&user" "&pw"
