// SPDX-FileCopyrightText: 2024 Christoph Sax <c_sax@mailbox.org>
//
// SPDX-License-Identifier: EUPL-1.2

private &a
Local &b
gLoBaL &c

entry &a
ENtry &b

parameters &a
ParameterS &b

returnvalues &a
rETurnvalues &b
