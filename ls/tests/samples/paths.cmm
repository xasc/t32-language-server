// SPDX-FileCopyrightText: 2024 Christoph Sax <c_sax@mailbox.org>
//
// SPDX-License-Identifier: EUPL-1.2

DO ~~~~/same.cmm
DO ~~~~/a/same.cmm
DO ~~~~/b/same.cmm

DO ~~~~/a/d/d.cmm
