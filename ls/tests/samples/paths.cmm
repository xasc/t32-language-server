DO ~~~~/same.cmm
DO ~~~~/a/same.cmm
DO ~~~~/b/same.cmm

DO ~~~~/a/d/d.cmm
