// SPDX-FileCopyrightText: 2024 Christoph Sax <c_sax@mailbox.org>
//
// SPDX-License-Identifier: EUPL-1.2

PRINT "This is C"

DO "a/a.cmm"

DO "d/d.cmmt"

// What subscript is called here depends on the the
// current working directory:
//   samples → samples/same.cmm
//   samples/a → samples/a/same.cmm
//   samples/b → samples/b/same.cmm
DO same.cmm

LOCAL &local_macro
DO "a/a.cmm"

subA:
(
    LOCAL &from_c_cmm

    DO "a/a.cmm"

    RETURN
)

GOSUB subA

PRINT "&global_macro"
