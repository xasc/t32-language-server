// SPDX-FileCopyrightText: 2024 Christoph Sax <c_sax@mailbox.org>
//
// SPDX-License-Identifier: AGPL-3.0-or-later

PRINT "This is A"

PRIVATE &private_macro

&private_macro="1"


IF &private_macro
(
    // No docstring

    // Docstring
    // Part A
    // Part B
    PRIVATE &nested_macro

    &nested_macro = 0x0--0x100

    Data.Set &nested_macro 1.
)

; First subroutine
SUBROUTINE subA
(
    ENTRY &a

    RETURN
)

subB:
(
    ENTRY &a &b

)

GLOBAL &global_macro
LOCAL &local_macro

GOSUB subA

// This is a subroutine call
GOSUB subB
