// SPDX-FileCopyrightText: 2024 Christoph Sax <c_sax@mailbox.org>
//
// SPDX-License-Identifier: EUPL-1.2

PRINT "This is B"

// This subscript call has only one valid candidate:
//   samples/a → samples/same.cmm
//   samples/a/d → samples/a/same.cmm
DO ../same.cmm
